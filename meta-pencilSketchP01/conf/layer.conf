## meta-pencilSketchP01/conf/layer.conf
```bitbake
# We have a conf and classes directory, add to BBPATH
BBPATH .= ":${LAYERDIR}"

# We have recipes-* directories, add to BBFILES
BBFILES += "${LAYERDIR}/recipes-*/*/*.bb \
            ${LAYERDIR}/recipes-*/*/*.bbappend"

BBFILE_COLLECTIONS += "meta-pencilSketch"
BBFILE_PATTERN_meta-pencilSketch = "^${LAYERDIR}/"
BBFILE_PRIORITY_meta-pencilSketch = "6"

LAYERDEPENDS_meta-pencilSketch = "core"
LAYERSERIES_COMPAT_meta-pencilSketch = "hardknott"
```
